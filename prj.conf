## CMakeLists.txt
```
# SPDX-License-Identifier: Apache-2.0

cmake_minimum_required(VERSION 3.20.0)

find_package(Zephyr REQUIRED HINTS $ENV{ZEPHYR_BASE})
project(ADC_for_Vape)

target_sources(app PRIVATE 
    src/main.c
    src/saadc.c
    src/error_handling.c
    src/timer_and_ppi.c
)
```

## prj.conf
```kconfig
CONFIG_LOG=y
CONFIG_LOG_DEFAULT_LEVEL=3

CONFIG_NRFX_PPI=y
CONFIG_NRFX_SAADC=y
CONFIG_NRFX_TIMER2=y
```

## src/main.c
```c
#include "error_handling.h"
#include "global_config.h"
#include "saadc.h"
#include "timer_and_ppi.h"
#include <zephyr/kernel.h>
#include <zephyr/logging/log.h>

LOG_MODULE_REGISTER(VAPE);
K_SEM_DEFINE(saadc_done_sem, 0, 1);
K_SEM_DEFINE(saadc_ready_sem, 0, 1);

//  Declare variable used to keep track of which buffer was last assigned to the SAADC driver
uint8_t saadc_buffer_num = 0;
volatile int16_t *saadc_results;
uint32_t vddh_div5_voltage_nV = 0;
uint32_t coil_current_uA      = 0;
uint32_t coil_resistance_mOhm = 0;

void saadc_handler(nrfx_saadc_evt_t const *p_event)
{
    // LOG_INF("SAADC evt %d", p_event->type);
    switch (p_event->type)
    {

    case NRFX_SAADC_EVT_DONE:
        saadc_results = p_event->data.done.p_buffer;
        k_sem_give(&saadc_done_sem);
        break;

    case NRFX_SAADC_EVT_BUF_REQ:
        // set alternating buffer for double buffering
        saadc_update_buffer((saadc_buffer_num++) % 2);
        break;

    case NRFX_SAADC_EVT_READY:
        // Buffer is ready, timer (and sampling) can be started
        k_sem_give(&saadc_ready_sem);
        break;

    default:
        LOG_ERR("unhandled SAADC evt %d", p_event->type);
        break;
    }
}

void start_heating(void)
{
    nrf_gpio_pin_set(POWER_MOSFET); // => ON
    nrf_gpio_pin_clear(RED_LED);    // => ON

    k_usleep(10); // wait until POWER_MOSFET is fully turned on

    timer_for_saadc_sampling_start();
    nrf_saadc_task_trigger(NRF_SAADC, NRF_SAADC_TASK_SAMPLE); // needed to start first SAADC sampling instantly, then PPI handles it via Timer CC
}

void stop_heating(void)
{
    nrf_gpio_pin_clear(POWER_MOSFET); // => OFF
    nrf_gpio_pin_set(RED_LED);        // => OFF
    timer_for_saadc_sampling_stop();

    k_msleep(TURN_ON_INTERVAL_MS);

    start_heating();
}

int main(void)
{
    nrf_gpio_cfg_output(POWER_MOSFET);
    nrf_gpio_pin_clear(POWER_MOSFET); // => OFF

    nrf_gpio_cfg_output(RED_LED);
    nrf_gpio_pin_set(RED_LED); // => OFF

    timer_init();
    saadc_init(saadc_handler);
    ppi_init();

    k_sem_take(&saadc_ready_sem, K_FOREVER); // wait unti SAADC is ready
    start_heating();

    for (;;)
    {
        k_sem_take(&saadc_done_sem, K_FOREVER);

        vddh_div5_voltage_nV = (uint32_t)saadc_results[0] * FACTOR_RAW_BATTERY_TO_VOLTAGE_nV;
        coil_current_uA      = (uint32_t)saadc_results[1] * FACTOR_RAW_COIL_TO_AMPERE_uA;

        coil_resistance_mOhm = vddh_div5_voltage_nV / coil_current_uA;

        LOG_INF("%u nV, %u uA, %u mOhm", vddh_div5_voltage_nV, coil_current_uA, coil_resistance_mOhm);

        if (coil_resistance_mOhm > 300000)
        {
            stop_heating();
        }
    }
}
```

## src/error_handling.c
```c
#include "error_handling.h"

int nrfx_err = NRFX_SUCCESS;
int err      = 0;

// TODO: perform reboot or similar
void error_handling(void)
{
}
```

## src/error_handling.h
```c
#ifndef ERROR_HANDLING_H
#define ERROR_HANDLING_H

#include <zephyr/kernel.h>
#include <zephyr/logging/log.h>

#define NRFX_ERR_CHECK(nrfx_err, msg)   \
    if (nrfx_err != NRFX_SUCCESS)       \
    {                                   \
        LOG_ERR(msg " - %d", nrfx_err); \
        error_handling();               \
    }
#define ERR_CHECK(err, msg)        \
    if (err)                       \
    {                              \
        LOG_ERR(msg " - %d", err); \
        error_handling();          \
    }

extern int nrfx_err;
extern int err;

void error_handling(void);

#endif
```

## src/global_config.h
```c
#ifndef GLOBAL_CONFIG_H
#define GLOBAL_CONFIG_H

#include <hal/nrf_gpio.h>

#define RED_LED      NRF_GPIO_PIN_MAP(0, 13)
#define POWER_MOSFET NRF_GPIO_PIN_MAP(0, 29)

#define POWER_MOSFET_TURN_ON_TIME_US     10
#define TURN_ON_INTERVAL_MS              100
#define SAADC_SAMPLE_INTERVAL_US         200
#define SAADC_BUF_SIZE                   2
#define FACTOR_RAW_BATTERY_TO_VOLTAGE_nV 1464000
#define FACTOR_RAW_COIL_TO_AMPERE_uA     7320 - 6500000
#define TIME_TO_SYSTEM_OFF_S             30

#endif
```

## src/saadc.c
```c
#include "saadc.h"

LOG_MODULE_REGISTER(saadc);

static int16_t saadc_samples[2][SAADC_BUF_SIZE];

static const nrfx_saadc_adv_config_t saadc_peripheral_config = {
    .oversampling      = NRF_SAADC_OVERSAMPLE_DISABLED,
    .burst             = NRF_SAADC_BURST_DISABLED,
    .internal_timer_cc = 0,
    .start_on_end      = false}; // when false then PPI must handle it

static const nrfx_saadc_channel_t saadc_battery_voltage_channel_config = {
    .channel_config = {
        .resistor_p = NRF_SAADC_RESISTOR_DISABLED,
        .resistor_n = NRF_SAADC_RESISTOR_DISABLED,
        .gain       = NRF_SAADC_GAIN1_5,
        .reference  = NRF_SAADC_REFERENCE_INTERNAL,
        .acq_time   = NRF_SAADC_ACQTIME_5US, // min 10us when VDDHDIV5 as input
        .mode       = NRF_SAADC_MODE_SINGLE_ENDED,
        .burst      = NRF_SAADC_BURST_DISABLED},
    .pin_p         = (nrf_saadc_input_t)NRF_SAADC_INPUT_AIN1,
    .pin_n         = NRF_SAADC_INPUT_DISABLED,
    .channel_index = 0};

static const nrfx_saadc_channel_t saadc_coil_current_channel_config = {
    .channel_config = {
        .resistor_p = NRF_SAADC_RESISTOR_DISABLED,
        .resistor_n = NRF_SAADC_RESISTOR_DISABLED,
        .gain       = NRF_SAADC_GAIN1_5,
        .reference  = NRF_SAADC_REFERENCE_INTERNAL,
        .acq_time   = NRF_SAADC_ACQTIME_5US,
        .mode       = NRF_SAADC_MODE_SINGLE_ENDED,
        .burst      = NRF_SAADC_BURST_DISABLED},
    .pin_p         = (nrf_saadc_input_t)NRF_SAADC_INPUT_AIN4,
    .pin_n         = NRF_SAADC_INPUT_DISABLED,
    .channel_index = 1};

void saadc_init(nrfx_saadc_event_handler_t saadc_event_handler)
{
    // Connect ADC interrupt to nrfx interrupt handler
    IRQ_CONNECT(DT_IRQN(DT_NODELABEL(adc)),
                DT_IRQ(DT_NODELABEL(adc), priority),
                nrfx_isr, nrfx_saadc_irq_handler, 0);

    nrfx_err = nrfx_saadc_init(DT_IRQ(DT_NODELABEL(adc), priority));
    NRFX_ERR_CHECK(nrfx_err, "initializing SAADC peripheral failed");

    // calibration should be performed when SoC temp changes 10°C
    nrfx_err = nrfx_saadc_offset_calibrate(NULL);
    NRFX_ERR_CHECK(nrfx_err, "Cannot calibrate SAADC")

    nrfx_err = nrfx_saadc_channel_config(&saadc_battery_voltage_channel_config);
    nrfx_err = nrfx_saadc_channel_config(&saadc_coil_current_channel_config);
    NRFX_ERR_CHECK(nrfx_err, "Configuring SAADC channels failed");

    nrfx_err = nrfx_saadc_advanced_mode_set(nrfx_saadc_channels_configured_get(),
                                            NRF_SAADC_RESOLUTION_12BIT,
                                            &saadc_peripheral_config,
                                            saadc_event_handler);
    NRFX_ERR_CHECK(nrfx_err, "setting SAADC mode failed");

    // Configure two buffers to make use of double-buffering feature of SAADC
    nrfx_err = nrfx_saadc_buffer_set(&saadc_samples[0], SAADC_BUF_SIZE);
    nrfx_err = nrfx_saadc_buffer_set(&saadc_samples[1], SAADC_BUF_SIZE);
    NRFX_ERR_CHECK(nrfx_err, "setting SAADC buffer failed failed");

    // Trigger the SAADC. This will not start sampling, but will prepare buffer for sampling triggered through PPI
    nrfx_err = nrfx_saadc_mode_trigger();
    NRFX_ERR_CHECK(nrfx_err, "triggering SAADC mode failed");
}

void saadc_update_buffer(uint8_t buffer_num)
{
    nrfx_err = nrfx_saadc_buffer_set(&saadc_samples[buffer_num], SAADC_BUF_SIZE);
    NRFX_ERR_CHECK(nrfx_err, " failed");
}
```

## src/saadc.h
```c
#ifndef SAADC_H
#define SAADC_H

#include "error_handling.h"
#include "global_config.h"
#include <nrfx_saadc.h>
#include <zephyr/logging/log.h>

void saadc_init(nrfx_saadc_event_handler_t saadc_event_handler);
void saadc_update_buffer(uint8_t buffer_num);

#endif
```

## src/timer_and_ppi.c
```c
#include "timer_and_ppi.h"

LOG_MODULE_REGISTER(timer_and_ppi);

static const nrfx_timer_t timer_to_sample_saadc_via_ppi_instance = NRFX_TIMER_INSTANCE(2); // never use TIMER0 as it is used by BLE SoftDevice

static const nrfx_timer_config_t timer_config = {
    .frequency          = 1000000,
    .mode               = NRF_TIMER_MODE_TIMER,
    .bit_width          = NRF_TIMER_BIT_WIDTH_32,
    .interrupt_priority = NRFX_TIMER_DEFAULT_CONFIG_IRQ_PRIORITY,
    .p_context          = NULL};

// will be connected to timer and used to determine the frequency of the SAADC measurements
static nrf_ppi_channel_t ppi_channel_to_sample_saadc_via_timer;
// will be connected to the end event of SAADC and enables scan measurment through all activ SAADC channels,
// without this, .start_on_end in nrfx_saadc_adv_config_t must be set to true. But via PPI its more efficient.
static nrf_ppi_channel_t ppi_channel_to_start_next_saadc_channel_on_end;

void timer_init(void)
{
    nrfx_err = nrfx_timer_init(&timer_to_sample_saadc_via_ppi_instance,
                               &timer_config,
                               NULL);
    NRFX_ERR_CHECK(nrfx_err, "timer initialization failed");

    nrfx_timer_extended_compare(&timer_to_sample_saadc_via_ppi_instance,
                                NRF_TIMER_CC_CHANNEL0,
                                nrfx_timer_us_to_ticks(&timer_to_sample_saadc_via_ppi_instance, SAADC_SAMPLE_INTERVAL_US),
                                NRF_TIMER_SHORT_COMPARE0_CLEAR_MASK,
                                false);
}

void ppi_init(void)
{
    nrfx_err = nrfx_ppi_channel_alloc(&ppi_channel_to_sample_saadc_via_timer);
    NRFX_ERR_CHECK(nrfx_err, "ppi timer alloc failed");
    nrfx_err = nrfx_ppi_channel_alloc(&ppi_channel_to_start_next_saadc_channel_on_end);
    NRFX_ERR_CHECK(nrfx_err, "ppi start on end alloc failed");

    // Trigger task sample from timer
    nrfx_err = nrfx_ppi_channel_assign(ppi_channel_to_sample_saadc_via_timer,
                                       nrfx_timer_compare_event_address_get(&timer_to_sample_saadc_via_ppi_instance, NRF_TIMER_CC_CHANNEL0),
                                       nrf_saadc_task_address_get(NRF_SAADC, NRF_SAADC_TASK_SAMPLE));
    NRFX_ERR_CHECK(nrfx_err, "ppi timer assign failed");

    // Trigger task start from end event
    nrfx_err = nrfx_ppi_channel_assign(ppi_channel_to_start_next_saadc_channel_on_end,
                                       nrf_saadc_event_address_get(NRF_SAADC, NRF_SAADC_EVENT_END),
                                       nrf_saadc_task_address_get(NRF_SAADC, NRF_SAADC_TASK_START));
    NRFX_ERR_CHECK(nrfx_err, "ppi start on end assign failed");

    nrfx_err = nrfx_ppi_channel_enable(ppi_channel_to_sample_saadc_via_timer);
    NRFX_ERR_CHECK(nrfx_err, "ppi timer enable failed");

    nrfx_err = nrfx_ppi_channel_enable(ppi_channel_to_start_next_saadc_channel_on_end);
    NRFX_ERR_CHECK(nrfx_err, "ppi start on end enable failed");
}

void timer_for_saadc_sampling_start(void)
{
    nrfx_timer_enable(&timer_to_sample_saadc_via_ppi_instance);
}

void timer_for_saadc_sampling_stop(void)
{
    nrfx_timer_disable(&timer_to_sample_saadc_via_ppi_instance);
    nrfx_timer_clear(&timer_to_sample_saadc_via_ppi_instance); // resets timer counter to 0
}
```

## src/timer_and_ppi.h
```c
#ifndef TIMER_AND_PPI_H
#define TIMER_AND_PPI_H

#include "error_handling.h"
#include "global_config.h"
#include <nrfx_ppi.h>
#include <nrfx_saadc.h>
#include <nrfx_timer.h>
#include <zephyr/logging/log.h>

void timer_init(void);
void ppi_init(void);
void timer_for_saadc_sampling_start(void);
void timer_for_saadc_sampling_stop(void);

#endif
```
